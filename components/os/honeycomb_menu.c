/**
 * @file honeycomb_menu.c
 * @brief Honeycomb (Cellular) Icon Select Menu for ESP32-S3 with LVGL v9
 * 
 * Uses LVGL v9 public APIs only. No embedded PNG data needed — icons are
 * generated as simple colored-circle image descriptors at startup.
 */

#include "honeycomb_menu.h"
#include "hw_display.h"
#include "png_images_circle.h"
#include "app_events.h"
#include "app_config.h"
#include "js_app_registry.h"
#include "esp_log.h"
#include "esp_heap_caps.h"
#include "esp_timer.h"
#include "freertos/FreeRTOS.h"
#include "freertos/task.h"
#include <string.h>
#include <stdlib.h>
/* Private LVGL low-level scroll — lets the spring move X without deleting
 * pending scroll animations (lv_obj_scroll_by(...,LV_ANIM_OFF) deletes
 * scroll_x_anim/scroll_y_anim, which kills the vertical snap animation). */
#include "core/lv_obj_scroll_private.h"

static const char *TAG = "honeycomb";

/*============================================================================
 * Feature Toggles
 *============================================================================*/

/** When 1: only create as many icons as available (no cycling).
 *  When 0: fill the hex grid — 19 icons = rings 0+1+2 (1+6+12)
 *  Now runtime-configurable via settings UI. */
static bool g_distinct_icons = false;

/** Total icon count (relevant when distinct-icons is OFF).
 *  Clamped to valid values for the current layout mode. */
static int g_icon_count = 19;

/** Resolution divisor (RAM-only, reset on reboot). */
static int g_res_divisor = 1;

/*============================================================================
 * Icon Arrays — all 96×96 RGB565 (generated by convert_png_prescale.py)
 *============================================================================*/
static const lv_image_dsc_t *s_icons[] = {
    &settings_96,
    &Activity_96,
    &alarm_clock_96,
    &app_store_96,
    &Audiobooks_96,
    &breathe_96,
    &calculator_96,
    &calendar_96,
    &camera_96,
    &clock_96,
    &Contacts_96,
    &Cycle_Tracking_96,
    &Depth_96,
    &ECG_96,
    &Find_Devices_96,
    &Find_Items_96,
    &Find_People_96,
    &Heart_Rate_96,
    &home_96,
    &imessage_96,
    &itunes_96,
    &mail_96,
    &maps_96,
    &Medicine_96,
    &Mindfulness_96,
    &Music_96,
    &News_96,
    &Noise_96,
    &Now_Playing_96,
    &Padcasts_96,     
    &phone_96,
    &photos_96,
    &pulse_96,
    &reminders_96,
    &remote_96,
    &Siren_96,
    &Sleep_96,
    &stocks_96,
    &stopwatch_96,
    &timer_96,
    &Tips_96,
    &Vitals_96,
    &Voice_Memos_96,
    &wallet_96,
    &weather_96,
    &workout_96,
    &world_clock_96
};
#define ICON_COUNT  (sizeof(s_icons) / sizeof(s_icons[0]))

/* SD-card JS apps: the decorative "calendar" slot is repurposed to show the
 * first installed JS app, so apps installed on the SD card appear in the
 * honeycomb launcher without being compiled into firmware. */
#define JSAPP_ICON_SLOT  7
static const lv_image_dsc_t *s_jsapp_icon = NULL;
static int s_jsapp_index = -1;

/*============================================================================
 * Layout Mode
 *============================================================================*/

static honeycomb_layout_mode_t g_layout_mode = HONEYCOMB_MODE_HEX_SPIRAL;

/* Vertical-view debug logger — reports the scroll position so the desired
 * initial position can be read from the serial log while scrolling.
 * Forward-declared so page_event_cb can call it. */
static void honeycomb_vert_debug_log(const char *why);

/*============================================================================
 * Display / Layout Constants — ESP32-S3 Touch AMOLED 2.06" = 410×502
 *============================================================================*/

#ifndef LCD_H_RES
#define LCD_H_RES  410
#endif
#ifndef LCD_V_RES
#define LCD_V_RES  502
#endif

#if (LCD_V_RES > LCD_H_RES)
    #define ICON_OUTER_RADIUS   (LCD_V_RES / 9)    /* ~55 */
#else
    #define ICON_OUTER_RADIUS   (LCD_H_RES / 9)
#endif

#define ICON_OUTER_DIAMETER     (ICON_OUTER_RADIUS * 2)   /* ~110 */
#define ICON_INNER_RADIUS       ((ICON_OUTER_RADIUS * 8) / 9)  /* ~48 */
#define ICON_INNER_DIAMETER     (ICON_INNER_RADIUS * 2)   /* ~96 */

#define MAX_APP_ROW_NUM         16
#define MAX_APP_COL_NUM         16

#define ICON_IMG_WIDTH          ICON_OUTER_DIAMETER
#define ICON_IMG_HEIGHT         ICON_OUTER_DIAMETER

#if (MAX_APP_ROW_NUM > MAX_APP_COL_NUM)
    #define PAGE_SCRL_WIDTH     ((ICON_OUTER_DIAMETER * (MAX_APP_ROW_NUM - 1)) + LCD_H_RES)
#else
    #define PAGE_SCRL_WIDTH     ((ICON_OUTER_DIAMETER * (MAX_APP_COL_NUM - 1)) + LCD_H_RES)
#endif

#define PAGE_SCRL_HEIGHT        (PAGE_SCRL_WIDTH * 10 / 7)

static int32_t g_c0r0_x = (PAGE_SCRL_WIDTH >> 1);
static int32_t g_c0r0_y = (PAGE_SCRL_HEIGHT >> 1);

#define LIMIT_RECT_WIDTH        (LCD_H_RES)
#define LIMIT_RECT_HEIGHT       (LCD_V_RES)
#if (LCD_V_RES > LCD_H_RES)
    #define LIMIT_ROUND_RADIUS   ((LCD_V_RES >> 1) + 25)
#else
    #define LIMIT_ROUND_RADIUS   (LCD_H_RES >> 1)
#endif

#define VERT_ICONS_PER_ROW_EVEN   3
#define VERT_ICONS_PER_ROW_ODD    4
/* Column pitch.  ICON_OUTER_DIAMETER (110) x 4 = 440 px does not fit the
 * 410 px panel, so the left/right icons were always clipped.  100 px keeps
 * a 4 px gap between the 96 px icons and a 5 px screen margin. */
#define VERT_COL_PITCH            ((LCD_H_RES - 10) / 4)
#define VERT_ROW_HEIGHT           ((ICON_OUTER_DIAMETER * 866) / 1000)
#define VERT_TOP_PADDING          (ICON_OUTER_RADIUS * 2)
#define VERT_PAGE_WIDTH           LCD_H_RES
#define VERT_PAGE_HEIGHT          (VERT_TOP_PADDING + 10 * VERT_ROW_HEIGHT)

/* Momentum (glide) scrolling on release — keep scrolling, slow down, then snap. */
#define THROW_MAX           360      /* cap total throw distance per axis (px) */
#define THROW_MIN_VEL       120      /* px/sec below which → snap, no throw */
#define THROW_MS            450      /* max glide duration (ms) */
#define THROW_DECEL         1000     /* desired deceleration (px/s²) — sets glide length */
#define VEL_SAMPLES         8        /* ring buffer of (scroll,time) samples */
#define VEL_WINDOW_US       150000   /* velocity window (150 ms) */
#define VEL_STALE_US        250000   /* scroll stopped this long ago → no glide */

/*============================================================================
 * Fixed-Point Q16.16 Math — ESP32-S3 has no FPU, so we avoid float entirely.
 *============================================================================*/

/* Convert float literal to Q16.16 at compile time */
#define FP(v)   ((int32_t)((v) * 65536.0f + 0.5f))

/* (a * b) >> 16  with int64 intermediate to prevent overflow */
#define FMUL(a, b)  ((int32_t)(((int64_t)(a) * (int64_t)(b)) >> 16))

/* Linear interpolate: A + (B-A)*t  where t is Q16.16, A/B are pixels */
#define FLERP(A, B, t)  ((int32_t)((A) + FMUL((int32_t)((B) - (A)), (t))))

/** Fast integer sqrt via Newton's method. Converges in ~5 iterations. */
static int32_t isqrt32(int32_t n)
{
    if (n <= 0) return 0;
    int32_t x = n;
    int32_t y = (x + 1) >> 1;
    while (y < x) { x = y; y = (x + n / x) >> 1; }
    return x;
}

/***** precomputed polynomial coefficients in Q16.16 *****/
static const int32_t FP_1   = FP(1.0f);
static const int32_t FP_030 = FP(0.30f);
static const int32_t FP_0125 = FP(0.125f);
static const int32_t FP_010 = FP(0.10f);
static const int32_t FP_006 = FP(0.06f);

/*============================================================================
 * Vertical X-axis spring + touch attraction
 *============================================================================
 *
 * Vertical mode is NOT Y-only: horizontal motion is allowed, but the X
 * offset behaves like a damped mass-spring-damper (a = −k·x − c·v) so it
 * naturally springs back to centre.  Integrated every 20 ms in fx_tick.
 *
 * Touch attraction (both layouts): icons within TOUCH_ATTR_RADIUS of the
 * touch point are gently pulled toward it, up to TOUCH_ATTR_MAX of their
 * distance.  The amount fades in/out with touch_strength so it never snaps.
 *============================================================================*/

#define SPRING_K_FP     FP(81.0f)   /* stiffness — ω0≈9 rad/s (ζ≈0.5) */
#define SPRING_C_FP     FP(9.0f)    /* damping (1/s) */
#define SPRING_DT_FP    FP(0.02f)   /* 20 ms integration step */

#define TOUCH_ATTR_RADIUS   220     /* px — icons nearer than this are pulled */
#define TOUCH_ATTR_MAX      FP(0.15f)  /* max pull fraction near the touch */
#define TOUCH_ATTR_SHRINK   0.22f   /* max size reduction near the touch (prevents
                                     * square-icon overlap where they bunch up) */

/*============================================================================
 * Fixed-Point Fisheye Transform (no division, no sqrtf)
 *
 * Polynomial:  mag(r)  = 1 - 0.30·r² + 0.10·r³   (icon scale)
 *              push(r) = mag(r) + 0.125·r²       (gap adjust ON, both
 *                        layouts: +25% — gap shrinks with icon size)
 *              push(r) = 1 + 0.06·r²             (gap adjust OFF)
 *
 * Key simplification:  new_x = cx + (dx/r)·(r·push) = cx + dx·push
 * (the r cancels — no division needed!)
 *============================================================================*/

static int get_icon_transform_param(int32_t x, int32_t y, int32_t icon_r,
                                     int32_t *p_x, int32_t *p_y,
                                     int32_t *p_icon_r, int32_t *p_pivot_r,
                                     int32_t scr_w, int32_t scr_h)
{
    int32_t cx = scr_w >> 1;
    int32_t cy = scr_h >> 1;
    int32_t dx = x - cx;
    int32_t dy = y - cy;

    /* r = sqrt(dx²+dy²) — integer sqrt */
    int32_t r = isqrt32(dx * dx + dy * dy);
    if (r < 1) r = 1;

    /* r_norm = r / (max_dim * 0.6)  clamped to [0, 1] in Q16.16 */
    int32_t max_dim = (scr_w > scr_h) ? scr_w : scr_h;
    int32_t max_norm = (max_dim * 39322) >> 16;   /* max_dim * 0.6, pixel scale */
    if (max_norm < 1) max_norm = 1;
    int32_t r_norm = ((int64_t)r << 16) / max_norm;  /* (r<<16)/max_norm = Q16.16 */
    if (r_norm > FP_1) r_norm = FP_1;

    int32_t r2 = FMUL(r_norm, r_norm);   /* r_norm²  Q16.16 */
    int32_t r3 = FMUL(r2, r_norm);       /* r_norm³  Q16.16 */

    /* magnification (Q16.16), clamp so icons don't vanish */
    int32_t mag = FP_1 - FMUL(FP_030, r2) + FMUL(FP_010, r3);
    if (mag < FP(0.05f)) mag = FP(0.05f);

    /* push factor (Q16.16)
     *
     * Gap adjust ON (+25%): spacing compresses slightly with the icon
     * size (push = mag + 0.125·r²), so the gap between neighbouring
     * icons shrinks as they scale down — applied to hex AND vertical.
     * Gap adjust OFF: original gentle outward push. */
    int32_t push;
    if (g_config.honeycomb_gap_adjust) {
        push = mag + FMUL(FP_0125, r2);
    } else {
        push = FP_1 + FMUL(FP_006, r2);
    }

    /* new_r = r * push (pixel scale) — used for center-finding only */
    int32_t new_r = FMUL(r, push);

    /* new position: cx + dx * push  (the r cancels — NO division!) */
    *p_x = cx + FMUL(dx, push);
    *p_y = cy + FMUL(dy, push);

    /* new icon radius (pixel scale) */
    *p_icon_r = FMUL(icon_r, mag);

    /* pivot distance from screen center (pixel scale) */
    *p_pivot_r = new_r;

    return (*p_icon_r < 2) ? 0 : 1;
}

/*============================================================================
 * Hexagonal Grid Coordinate System (original SiFli algorithm)
 *============================================================================*/

static void layout_get_icons_init_coordinate_spiral(int32_t row_idx, int32_t col_idx,
                                                     int32_t *x, int32_t *y)
{
    /* cos(60°)≈16384, sin(60°)≈28378 in LVGL fixed-point (Q15) */
    int32_t cos60 = 16384;
    int32_t sin60 = 28378;

    *x = ((col_idx - row_idx) * cos60 * ICON_OUTER_RADIUS) >> 14;
    *y = ((col_idx + row_idx) * sin60 * ICON_OUTER_RADIUS) >> 14;

    *x += g_c0r0_x;
    *y += g_c0r0_y;
}

/*============================================================================
 * Vertical Grid Coordinate System (Apple WatchOS-style)
 * Even rows: 3 icons, Odd rows: 4 icons — so the FIRST row (row 0) has 3.
 *============================================================================*/

static void layout_get_icons_init_coordinate_vertical(int32_t row_idx, int32_t col_idx,
                                                       int32_t *x, int32_t *y)
{
    int32_t icons_in_row = (row_idx % 2 == 0) ? VERT_ICONS_PER_ROW_EVEN : VERT_ICONS_PER_ROW_ODD;
    int32_t row_width = icons_in_row * VERT_COL_PITCH;

    /* Center the row horizontally within the screen width */
    *x = ((LCD_H_RES - row_width) / 2) + (VERT_COL_PITCH / 2) + (col_idx * VERT_COL_PITCH);
    *y = VERT_TOP_PADDING + (row_idx * VERT_ROW_HEIGHT) + (ICON_OUTER_RADIUS);
}

/*============================================================================
 * Unified coordinate dispatcher
 *============================================================================*/

static void layout_get_icons_init_coordinate(int32_t row_idx, int32_t col_idx,
                                              int32_t *x, int32_t *y)
{
    if (g_layout_mode == HONEYCOMB_MODE_VERTICAL_GRID) {
        layout_get_icons_init_coordinate_vertical(row_idx, col_idx, x, y);
    } else {
        layout_get_icons_init_coordinate_spiral(row_idx, col_idx, x, y);
    }
}

/**
 * Map linear index to hex-spiral (col, row).
 *
 * Spiral pattern (index 0 at center):
 *       19___20___21___22
 *        |              \
 *        |  7___8___9   23
 *        |  |        \    \
 *       18  | 1___2   10   24
 *      /    |  \   \   \    \
 *     17    6   0   3   11   25
 *      \     \     /   /     /
 *       16    5___4   12    26
 *        \           /      /
 *         15___14___13    27
 */
static void layout_get_icon_col_row_by_idx_spiral(uint16_t idx, uint16_t *p_col,
                                                    uint16_t *p_row)
{
    int16_t col, row;

    if (idx == 0) {
        col = 0; row = 0;
    } else {
        uint16_t total = 0, hexagon_r = 0, hexagon_icons = 1;

        while (total + hexagon_icons - 1 < idx) {
            total += hexagon_icons;
            hexagon_r++;
            hexagon_icons = hexagon_r * 6;
        }

        uint16_t one_edge_icons = hexagon_r + 1;
        row = 0;
        col = 0 - (int16_t)hexagon_r;

        for (uint16_t i = 0; i < hexagon_icons; i++) {
            if (total + i == idx) break;

            switch (i / (one_edge_icons - 1)) {
            case 0: col++; row--; break;
            case 1: col++;        break;
            case 2:        row++; break;
            case 3: col--; row++; break;
            case 4: col--;        break;
            case 5:        row--; break;
            default:              break;
            }
        }
    }

    *p_col = (uint16_t)(col + (MAX_APP_COL_NUM >> 1));
    *p_row = (uint16_t)(row + (MAX_APP_ROW_NUM >> 1));
}

/**
 * Map linear index to vertical grid (col, row).
 *
 * Apple WatchOS-style staggered grid:
 *   Row 0 (even):   [0] [1] [2]     ← 3 icons (centered)
 *   Row 1 (odd): [3] [4] [5] [6]    ← 4 icons
 *   Row 2 (even):   [7] [8] [9]     ← 3 icons (centered)
 *   ...
 */
static void layout_get_icon_col_row_by_idx_vertical(uint16_t idx, uint16_t *p_col,
                                                      uint16_t *p_row)
{
    uint16_t remaining = idx;
    uint16_t row = 0;

    while (1) {
        uint16_t icons_in_row = (row % 2 == 0) ? VERT_ICONS_PER_ROW_EVEN : VERT_ICONS_PER_ROW_ODD;
        if (remaining < icons_in_row) {
            *p_row = row;
            *p_col = remaining;
            return;
        }
        remaining -= icons_in_row;
        row++;
    }
}

/*============================================================================
 * Unified index-to-col/row dispatcher
 *============================================================================*/

static void layout_get_icon_col_row_by_idx(uint16_t idx, uint16_t *p_col,
                                            uint16_t *p_row)
{
    if (g_layout_mode == HONEYCOMB_MODE_VERTICAL_GRID) {
        layout_get_icon_col_row_by_idx_vertical(idx, p_col, p_row);
    } else {
        layout_get_icon_col_row_by_idx_spiral(idx, p_col, p_row);
    }
}

/*============================================================================
 * Screen Boundary Clipping (integer)
 *============================================================================*/

static bool limit_square(lv_area_t *parent_area, int32_t *x, int32_t *y, int32_t *icon_r)
{
    int32_t res_x1 = LV_MAX(parent_area->x1, *x - *icon_r);
    int32_t res_y1 = LV_MAX(parent_area->y1, *y - *icon_r);
    int32_t res_x2 = LV_MIN(parent_area->x2, *x + *icon_r);
    int32_t res_y2 = LV_MIN(parent_area->y2, *y + *icon_r);

    if (res_x1 > res_x2 || res_y1 > res_y2) { *icon_r = 0; return false; }

    int32_t new_w = res_x2 - res_x1 + 1;
    int32_t new_h = res_y2 - res_y1 + 1;
    *icon_r = (new_w < new_h) ? (new_w >> 1) : (new_h >> 1);
    *x = res_x1 + (new_w >> 1);
    *y = res_y1 + (new_h >> 1);
    return true;
}

static void limit_round2(int32_t limit_r, lv_point_t *zoom_pivot,
                          int32_t *x, int32_t *y, int32_t *icon_r, int32_t pivot_r)
{
    if (pivot_r + *icon_r > limit_r) {
        if (pivot_r - *icon_r < limit_r) {
            int32_t old_w = *x - zoom_pivot->x;
            int32_t old_h = *y - zoom_pivot->y;
            *icon_r = (limit_r - (pivot_r - *icon_r)) >> 1;
            int32_t new_pr = limit_r - *icon_r;
            if (pivot_r > 0) {
                *x += (int32_t)(((int64_t)old_w * new_pr) / pivot_r) - old_w;
                *y += (int32_t)(((int64_t)old_h * new_pr) / pivot_r) - old_h;
            }
        } else {
            *icon_r = 0;
        }
    }
}

/*============================================================================
 * Full Icon Transform Pipeline (integer)
 *============================================================================*/

static int layout_icon_transform(uint32_t row_idx, uint32_t col_idx,
                                  int32_t *p_x, int32_t *p_y,
                                  int32_t *p_w, int32_t *p_h,
                                  int32_t *p_pivot_r)
{
    (void)row_idx; (void)col_idx;

    int32_t x = *p_x, y = *p_y, icon_r = (*p_w) >> 1, pivot_r;

    lv_point_t scr_center = { LCD_H_RES >> 1, LCD_V_RES >> 1 };

    lv_area_t parent_area;
    parent_area.x1 = (LCD_H_RES - LIMIT_RECT_WIDTH) >> 1;
    parent_area.y1 = (LCD_V_RES - LIMIT_RECT_HEIGHT) >> 1;
    parent_area.x2 = parent_area.x1 + LIMIT_RECT_WIDTH - 1;
    parent_area.y2 = parent_area.y1 + LIMIT_RECT_HEIGHT - 1;

    if (get_icon_transform_param(x, y, icon_r, &x, &y, &icon_r,
                                  &pivot_r, LCD_H_RES, LCD_V_RES))
    {
        limit_round2(LIMIT_ROUND_RADIUS, &scr_center, &x, &y, &icon_r, pivot_r);
        limit_square(&parent_area, &x, &y, &icon_r);
    } else {
        icon_r = 0; x = 0; y = 0;
    }

    if (icon_r >= (ICON_OUTER_RADIUS - ICON_INNER_RADIUS))
        icon_r -= (ICON_OUTER_RADIUS - ICON_INNER_RADIUS);
    else
        icon_r = 0;

    *p_x = x; *p_y = y; *p_w = icon_r * 2; *p_pivot_r = pivot_r;
    return (icon_r == 0) ? 0 : 1;
}

/*============================================================================
 * Menu State
 *============================================================================*/

typedef struct {
    lv_obj_t    *page_obj;
    lv_obj_t   **icon_list;
    lv_point_t  *icon_pivot;
    lv_obj_t    *center_icon;
    lv_obj_t    *anim_obj;
    float        zoom;
    float        target_zoom;
    uint8_t      focus_row;
    uint8_t      focus_col;
    bool         scroll_active;
    bool         gesture_moved;     /* current press actually dragged (blocks fake clicks) */
    lv_point_t   scroll_sum;
    lv_point_t   scroll_vel;       /* computed release velocity (px/sec) */
    lv_point_t   throw_base;       /* get_scroll at release (throw origin) */
    lv_point_t   throw_total;      /* total glide distance */
    bool         throw_active;     /* glide is running (will snap on completion) */
    int64_t      vel_time[VEL_SAMPLES];    /* velocity sample timestamps (us) */
    int32_t      vel_pos[VEL_SAMPLES][2];  /* velocity sample get_scroll x/y */
    uint8_t      vel_idx;
    uint8_t      vel_count;
    lv_timer_t  *entry_timers[MAX_APP_ROW_NUM];  /* vertical entry-anim timers (deleted on destroy) */
    uint8_t      entry_timer_count;
    /* Vertical X-axis spring-return — horizontal motion is allowed but
     * naturally returns to centre (see honeycomb_fx_tick). */
    int32_t      spring_x_fp;     /* X offset from centre (Q16.16 px) */
    int32_t      spring_vx_fp;    /* spring velocity (Q16.16 px/s) */
    bool         spring_active;   /* spring is returning X to centre */
    /* Touch attraction (hex + vertical) — surrounding icons lean toward the
     * touch point while a finger is down. */
    bool         touch_active;    /* a finger is currently down */
    lv_point_t   touch_point;     /* current touch position (screen coords) */
    float        touch_strength;  /* 0..1 smoothed attraction amount */
    lv_timer_t  *fx_timer;        /* 20ms driver: vertical spring + touch fade */
} honeycomb_menu_t;

static honeycomb_menu_t *g_menu = NULL;
/* True while honeycomb_menu_destroy() is tearing the menu down, so a nested
 * call (SCROLL_END fired by lv_anim_delete) can't free state twice. */
static bool s_destroying = false;

/*============================================================================
 * Icon Array Accessors
 *============================================================================*/

static lv_obj_t **honeycomb_get_icon_obj(uint32_t row, uint32_t col)
{
    if (row >= MAX_APP_ROW_NUM || col >= MAX_APP_COL_NUM) return NULL;
    return &(g_menu->icon_list[col * MAX_APP_ROW_NUM + row]);
}

static lv_point_t *honeycomb_get_icon_pivot(uint32_t row, uint32_t col)
{
    if (row >= MAX_APP_ROW_NUM || col >= MAX_APP_COL_NUM) return NULL;
    return &(g_menu->icon_pivot[col * MAX_APP_ROW_NUM + row]);
}

/* The image inside an icon's clip container.  The container carries the
 * position + the temporary circular clip; the image carries the picture
 * + the zoom.  (The image is always the container's only child.) */
#define honeycomb_icon_image(con)   lv_obj_get_child((con), 0)

/* Entry-animation drivers (defined below).  Forward-declared so
 * honeycomb_draw_icon can tell whether an icon is still being entry-animated
 * and leave its scale/position alone. */
static void vertical_icon_scale_anim_cb(void *obj, int32_t value);
static void vertical_icon_pos_anim_cb(void *obj, int32_t value);
static void vertical_icon_pos_x_anim_cb(void *obj, int32_t value);

/*============================================================================
 * Icon Drawing
 *============================================================================*/

static void honeycomb_draw_icon(lv_obj_t *obj, int32_t pi_x, int32_t pi_y,
                                 int32_t w, int32_t h)
{
    if (w > 4 && h > 4) {
        lv_obj_remove_flag(obj, LV_OBJ_FLAG_HIDDEN);
        /* obj is the clip container; the picture + zoom live in its child. */
        lv_obj_t *img = lv_obj_get_child(obj, 0);
        int32_t ow = 0, oh = 0;
        if (img) {
            const lv_image_dsc_t *dsc = lv_image_get_src(img);
            if (dsc) { ow = dsc->header.w; oh = dsc->header.h; }
        }
        if (ow <= 0) ow = ICON_IMG_WIDTH;
        if (oh <= 0) oh = ICON_IMG_HEIGHT;
        uint16_t s = (uint16_t)((w * 256) / ow);
        if (s < 16) s = 16;
        /* Don't clobber the entry jelly animation: while an icon has an
         * active scale/position animation it must keep the animation's
         * values, or the fisheye transform snaps it back mid-pop. */
        if (img && lv_anim_get(img, vertical_icon_scale_anim_cb) == NULL) {
            lv_image_set_scale(img, s);
        }
        if (img) lv_image_set_pivot(img, ow >> 1, oh >> 1);
        if (lv_anim_get(obj, vertical_icon_pos_anim_cb) == NULL &&
            lv_anim_get(obj, vertical_icon_pos_x_anim_cb) == NULL) {
            lv_obj_set_pos(obj,
                pi_x - (ICON_OUTER_DIAMETER >> 1) + lv_obj_get_scroll_x(g_menu->page_obj),
                pi_y - (ICON_OUTER_DIAMETER >> 1) + lv_obj_get_scroll_y(g_menu->page_obj));
        }
    } else {
        lv_obj_add_flag(obj, LV_OBJ_FLAG_HIDDEN);
    }
}

/*============================================================================
 * Grid Initialization
 *============================================================================*/

static void honeycomb_coord_init(void)
{
    for (uint8_t row = 0; row < MAX_APP_ROW_NUM; row++) {
        for (uint8_t col = 0; col < MAX_APP_COL_NUM; col++) {
            int32_t x, y;
            layout_get_icons_init_coordinate(row, col, &x, &y);

            honeycomb_get_icon_pivot(row, col)->x = x;
            honeycomb_get_icon_pivot(row, col)->y = y;

            lv_obj_t *con = *honeycomb_get_icon_obj(row, col);
            if (con) {
                lv_obj_t *img = lv_obj_get_child(con, 0);
                if (img) {
                    int32_t iw = lv_obj_get_width(img);
                    int32_t ih = lv_obj_get_height(img);
                    if (iw > 0 && ih > 0) {
                        uint16_t scale = (uint16_t)(ICON_IMG_WIDTH * 256 / iw);
                        lv_image_set_pivot(img, iw >> 1, ih >> 1);
                        lv_image_set_scale(img, scale);
                    }
                }
                lv_obj_set_pos(con,
                               x - (ICON_IMG_WIDTH >> 1),
                               y - (ICON_IMG_HEIGHT >> 1));
            }
        }
    }

}

/*============================================================================
 * Main Transform
 *============================================================================*/

/* Sequential update: draw ICONS_PER_TICK icons each frame, cycling through
 * all icons.  Reduces the per-flush dirty-area count → smaller SPI bursts
 * → less visible tearing from partial framebuffer flushes.
 * On force_refresh (init / delayed refresh), draw all icons at once. */
/*============================================================================
 * Main Transform
 *============================================================================*/

static void honeycomb_transform(bool force_refresh)
{
    static int32_t c0r0_x = 0, c0r0_y = 0;
    static float   prev_touch_strength = 0.0f;

    int32_t cur_c0r0_x = g_c0r0_x - lv_obj_get_scroll_x(g_menu->page_obj);
    int32_t cur_c0r0_y = g_c0r0_y - lv_obj_get_scroll_y(g_menu->page_obj);

    if (c0r0_x == cur_c0r0_x && c0r0_y == cur_c0r0_y &&
        g_menu->target_zoom == g_menu->zoom &&
        prev_touch_strength == g_menu->touch_strength && !force_refresh)
        return;

    c0r0_x = cur_c0r0_x;
    c0r0_y = cur_c0r0_y;
    prev_touch_strength = g_menu->touch_strength;

    int32_t x_off = c0r0_x - honeycomb_get_icon_pivot(0, 0)->x;
    int32_t y_off = c0r0_y - honeycomb_get_icon_pivot(0, 0)->y;

    int32_t min_delta = LCD_V_RES;
    int32_t scr_cx = LCD_H_RES >> 1;
    int32_t scr_cy = LCD_V_RES >> 1;
    int32_t zoom_fp = (int32_t)(g_menu->zoom * 65536.0f);

    for (uint8_t row = 0; row < MAX_APP_ROW_NUM; row++) {
        for (uint8_t col = 0; col < MAX_APP_COL_NUM; col++) {
            honeycomb_get_icon_pivot(row, col)->x += x_off;
            honeycomb_get_icon_pivot(row, col)->y += y_off;

            lv_obj_t *icon = *honeycomb_get_icon_obj(row, col);
            if (!icon) continue;

            int32_t fx = honeycomb_get_icon_pivot(row, col)->x;
            int32_t fy = honeycomb_get_icon_pivot(row, col)->y;
            int32_t fw = ICON_IMG_WIDTH, fh = ICON_IMG_HEIGHT;
            int32_t pivot_r, z_fp;

            if (g_menu->zoom < 1.0f) {
                z_fp = FMUL(zoom_fp, zoom_fp);        /* zoom² Q16.16 */
                fx = FLERP(scr_cx, fx, z_fp);
                fy = FLERP(scr_cy, fy, z_fp);
                fw = FMUL(fw, z_fp);
                fh = FMUL(fh, z_fp);
            }

            if (g_menu->zoom > 0.0f) {
                int32_t fx0 = fx, fy0 = fy, fw0 = fw;

                if (layout_icon_transform(row, col, &fx, &fy, &fw, &fh, &pivot_r)) {
                    if (pivot_r < min_delta) {
                        min_delta = pivot_r;
                        g_menu->center_icon = icon;
                    }
                    if (g_menu->zoom > 0.0f && g_menu->zoom <= 1.0f) {
                        fx = FLERP(fx0, fx, zoom_fp);
                        fy = FLERP(fy0, fy, zoom_fp);
                        fw = FLERP(fw0, fw, zoom_fp);
                        fh = FLERP(fw0, fh, zoom_fp);
                    }
                } else {
                    fw = 0; fh = 0; fx = 0; fy = 0;
                }
            }

            if (g_menu->zoom > 1.0f) {
                /* z = 1/(2-zoom) in Q16.16 */
                int32_t denom = FP(2.0f) - zoom_fp;
                z_fp = (denom > 0) ? ((int64_t)FP_1 << 16) / denom : FP_1;
                fx = FLERP(scr_cx, fx, z_fp);
                fy = FLERP(scr_cy, fy, z_fp);
                fw = FMUL(fw, z_fp);
                fh = FMUL(fh, z_fp);
            }

            /* Touch attraction: gently pull icons near the touch point
             * toward it AND shrink them a little, so the square (no-alpha,
             * no-clip-corner) icons don't overlap where they bunch up near
             * the finger.  Both the pull and the shrink peak at the touch
             * and fall off to 0 at TOUCH_ATTR_RADIUS, scaled by the
             * smoothed touch_strength. */
            if (g_menu->touch_strength > 0.005f) {
                int32_t tdx = g_menu->touch_point.x - fx;
                int32_t tdy = g_menu->touch_point.y - fy;
                int32_t td2 = tdx * tdx + tdy * tdy;
                if (td2 < (TOUCH_ATTR_RADIUS * TOUCH_ATTR_RADIUS)) {
                    int32_t td = isqrt32(td2);
                    if (td < 1) td = 1;
                    int32_t falloff = TOUCH_ATTR_RADIUS - td;
                    int32_t falloff_fp = ((int64_t)falloff << 16) / TOUCH_ATTR_RADIUS;
                    int32_t strength_fp = (int32_t)(g_menu->touch_strength * 65536.0f);
                    /* Pull toward the touch. */
                    int32_t k = FMUL(FMUL(TOUCH_ATTR_MAX, falloff_fp), strength_fp);
                    fx += FMUL(tdx, k);
                    fy += FMUL(tdy, k);
                    /* Shrink so bunched-up icons don't overlap. */
                    int32_t shrink = FMUL(FMUL(FP(TOUCH_ATTR_SHRINK), falloff_fp),
                                          strength_fp);
                    int32_t scale = FP_1 - shrink;
                    fw = FMUL(fw, scale);
                    fh = FMUL(fh, scale);
                }
            }

            honeycomb_draw_icon(icon, fx, fy, fw, fh);
        }
    }
}

/*============================================================================
 * Nearest Icon & Predict
 *============================================================================*/

static lv_obj_t *honeycomb_get_nearest_icon(lv_point_t *target)
{
    lv_obj_t *ret = NULL;
    int32_t min_d2 = 0;
    bool first = true;

    for (uint8_t r = 0; r < MAX_APP_ROW_NUM; r++)
        for (uint8_t c = 0; c < MAX_APP_COL_NUM; c++) {
            int32_t dx = honeycomb_get_icon_pivot(r, c)->x - target->x;
            int32_t dy = honeycomb_get_icon_pivot(r, c)->y - target->y;
            int32_t d2 = dx * dx + dy * dy;   /* squared distance — no sqrt needed */
            lv_obj_t *icon = *honeycomb_get_icon_obj(r, c);
            if (icon && (first || d2 < min_d2)) {
                ret = icon; min_d2 = d2; first = false;
            }
        }
    return ret;
}

/* Predict which icon the energy-conserved glide will land nearest the
 * screen centre on.  This runs in honeycomb_momentum_anim_done, i.e. AFTER
 * the throw has finished, so the live pivots already reflect the landing
 * scroll — the icon that ends up centred is simply the one currently
 * nearest the screen centre. */
static lv_obj_t *honeycomb_predict_landing_icon(void)
{
    lv_point_t target;
    target.x = LCD_H_RES >> 1;
    target.y = LCD_V_RES >> 1;
    return honeycomb_get_nearest_icon(&target);
}

/* Center an icon using UNBOUNDED raw scroll.  LVGL's scroll_to_view clamps
 * against the (wrong) camera-layout scroll range, so it fails to reach the
 * target when many icons are present / a larger scroll is needed.  Mirrors
 * the verified entry math: target get_scroll = pivot − centre, so scroll by
 * (current get_scroll − centre + pivot).
 *
 * Returns true if a scroll was actually started, false if the icon is
 * already centred (a zero delta would start no animation, so callers that
 * rely on SCROLL_END must handle this case themselves). */
static bool honeycomb_scroll_icon_to_center(lv_obj_t *icon, bool anim)
{
    if (!g_menu || !icon) return false;

    uint16_t row = 0, col = 0;
    bool found = false;
    for (uint16_t r = 0; r < MAX_APP_ROW_NUM && !found; r++) {
        for (uint16_t c = 0; c < MAX_APP_COL_NUM && !found; c++) {
            if (*honeycomb_get_icon_obj(r, c) == icon) { row = r; col = c; found = true; }
        }
    }
    if (!found) return false;

    int32_t cx, cy;
    layout_get_icons_init_coordinate(row, col, &cx, &cy);
    int32_t cur_x = lv_obj_get_scroll_x(g_menu->page_obj);
    int32_t cur_y = lv_obj_get_scroll_y(g_menu->page_obj);

    /* on-screen centre of an icon = its init coord − get_scroll, so to bring
     * it to the screen centre we need get_scroll = coord − centre.  Because
     * scroll_by(k) moves get_scroll by −k, the required delta is
     * cur − (coord − centre) = cur − coord + centre.  (The previous formula
     * had the coord/centre signs swapped, which mirrored the icon to
     * 2·coord − centre — blank space for icons far from centre.) */
    if (g_layout_mode == HONEYCOMB_MODE_VERTICAL_GRID) {
        int32_t dy = cur_y - cy + (LCD_V_RES >> 1);
        if (dy == 0) return false;   /* already on the centre row */
        lv_obj_scroll_by(g_menu->page_obj, 0, dy,
                         anim ? LV_ANIM_ON : LV_ANIM_OFF);
    } else {
        int32_t dx = cur_x - cx + (LCD_H_RES >> 1);
        int32_t dy = cur_y - cy + (LCD_V_RES >> 1);
        if (dx == 0 && dy == 0) return false;   /* already centred */
        lv_obj_scroll_by(g_menu->page_obj, dx, dy,
                         anim ? LV_ANIM_ON : LV_ANIM_OFF);
    }
    return true;
}

/*============================================================================
 * Event Callbacks
 *============================================================================*/

/* Record a (scroll position, timestamp) sample whenever the scroll actually
 * moves — used to estimate a reliable release velocity for the glide. */
static void honeycomb_vel_sample(lv_obj_t *page)
{
    if (!g_menu) return;
    int32_t sx = lv_obj_get_scroll_x(page);
    int32_t sy = lv_obj_get_scroll_y(page);
    int last = (g_menu->vel_idx - 1 + VEL_SAMPLES) % VEL_SAMPLES;
    if (g_menu->vel_count == 0 ||
        sx != g_menu->vel_pos[last][0] || sy != g_menu->vel_pos[last][1]) {
        g_menu->vel_pos[g_menu->vel_idx][0] = sx;
        g_menu->vel_pos[g_menu->vel_idx][1] = sy;
        g_menu->vel_time[g_menu->vel_idx] = esp_timer_get_time();
        g_menu->vel_idx = (g_menu->vel_idx + 1) % VEL_SAMPLES;
        if (g_menu->vel_count < VEL_SAMPLES) g_menu->vel_count++;
    }
}

static void refr_start_cb(lv_event_t *e)
{
    (void)e;
    if (!g_menu || !g_menu->page_obj) return;
    lv_obj_t *page = g_menu->page_obj;

    if (g_menu->scroll_active) {
        /* Vertical mode also moves horizontally, but the X offset is a
         * damped spring toward the centre.  The finger delta is applied
         * immediately (responsive) and mirrored into the spring state so
         * honeycomb_fx_tick can drive the return-to-centre motion.
         * NOTE: scroll_by(+dx) moves get_scroll_x by −dx, so the spring
         * tracks get_scroll_x with the SAME sign (subtract the delta) —
         * otherwise the spring fights the finger and the drag looks
         * inverted. */
        if (g_layout_mode == HONEYCOMB_MODE_VERTICAL_GRID &&
            g_menu->scroll_sum.x != 0) {
            g_menu->spring_x_fp -= (g_menu->scroll_sum.x << 16);
            g_menu->spring_active = true;
        }

        lv_obj_scroll_by(page, g_menu->scroll_sum.x, g_menu->scroll_sum.y,
                         LV_ANIM_OFF);
        g_menu->scroll_sum.x = 0;
        g_menu->scroll_sum.y = 0;
        honeycomb_vel_sample(page);
        honeycomb_transform(false);
    }
}

/* 20 ms driver that runs while the menu is alive:
 *   1. Vertical X-axis spring-return — integrates the damped spring so a
 *      horizontal drag (or flick) naturally settles back to centre.
 *   2. Touch-attraction strength fade — ramps the icon pull in/out so the
 *      surrounding icons ease toward the finger and ease back on release.
 * Only invalidates/transforms when something actually changed. */
static void honeycomb_fx_tick(lv_timer_t *t)
{
    (void)t;
    if (!g_menu || !g_menu->page_obj) return;

    bool dirty = false;

    /* 1) Vertical X-axis spring: a = −k·x − c·v (toward centre x = 0). */
    if (g_layout_mode == HONEYCOMB_MODE_VERTICAL_GRID && g_menu->spring_active) {
        int32_t accel = -FMUL(SPRING_K_FP, g_menu->spring_x_fp)
                        - FMUL(SPRING_C_FP, g_menu->spring_vx_fp);
        g_menu->spring_vx_fp += FMUL(accel, SPRING_DT_FP);
        g_menu->spring_x_fp  += FMUL(g_menu->spring_vx_fp, SPRING_DT_FP);

        /* Settle when essentially at centre and nearly motionless. */
        if (LV_ABS(g_menu->spring_x_fp) < FP(0.5f) &&
            LV_ABS(g_menu->spring_vx_fp) < FP(8.0f)) {
            g_menu->spring_x_fp  = 0;
            g_menu->spring_vx_fp = 0;
            g_menu->spring_active = false;
        }

        /* Bring the page X scroll to the spring position (round to px).
         * Use scroll_by_raw: it does NOT delete the Y snap animation that
         * honeycomb_scroll_icon_to_center started, and fires no SCROLL_END,
         * so the vertical snap can run to completion while X re-centres. */
        int32_t target = (g_menu->spring_x_fp + 32768) >> 16;
        int32_t cur = lv_obj_get_scroll_x(g_menu->page_obj);
        if (cur != target) {
            lv_obj_scroll_by_raw(g_menu->page_obj, cur - target, 0);
            dirty = true;
        }
    }

    /* 2) Touch-attraction strength: fade in while a finger is down, fade
     * out (and to exactly 0) after release. */
    if (g_menu->touch_active) {
        float prev = g_menu->touch_strength;
        g_menu->touch_strength += (1.0f - g_menu->touch_strength) * 0.15f;
        if (g_menu->touch_strength != prev) dirty = true;
    } else if (g_menu->touch_strength > 0.0f) {
        float prev = g_menu->touch_strength;
        g_menu->touch_strength *= 0.85f;
        if (g_menu->touch_strength < 0.002f) g_menu->touch_strength = 0.0f;
        if (g_menu->touch_strength != prev) dirty = true;
    }

    if (dirty) {
        honeycomb_transform(false);
        lv_obj_invalidate(g_menu->page_obj);
    }
}

/*============================================================================
 * Momentum (glide) throw — continue scrolling after release, slow down, snap.
 * Uses an unbounded custom lv_anim (NOT LVGL's range-bounded native scroll,
 * which breaks the camera-style hex layout).
 *============================================================================*/

/* Constant-deceleration glide path: position fraction = u(2−u) for u = t/T.
 * Its slope 2(1−u) means velocity falls linearly from the release value to 0.
 * The duration is set in honeycomb_start_momentum so the initial velocity
 * exactly matches the measured release velocity (no ease-out "kick"). */
static int32_t honeycomb_parabola_path(const lv_anim_t *a)
{
    int32_t dur = a->duration;
    if (dur <= 0) return a->end_value;
    int32_t u = (a->act_time * LV_SCALE_NONE) / dur;
    if (u < 0) u = 0;
    if (u > LV_SCALE_NONE) u = LV_SCALE_NONE;
    int32_t frac = (u * (2 * LV_SCALE_NONE - u)) / LV_SCALE_NONE;
    if (frac > LV_SCALE_NONE) frac = LV_SCALE_NONE;
    return a->start_value + ((a->end_value - a->start_value) * frac) / LV_SCALE_NONE;
}

/* Distance one axis covers while gliding for t_ms from release velocity v
 * (px/s) under the parabola path: d = v·t/2 (starts at v, decelerates to 0). */
static int32_t honeycomb_throw_axis(int32_t v, int32_t t_ms)
{
    if (v == 0) return 0;
    int32_t sign = (v > 0) ? 1 : -1;
    int64_t dist = (int64_t)LV_ABS(v) * t_ms / (2 * 1000);
    if (dist > THROW_MAX) dist = THROW_MAX;
    if (dist < 0) dist = 0;
    return (int32_t)dist * sign;
}

static void honeycomb_momentum_anim_cb(void *var, int32_t value)
{
    lv_obj_t *page = (lv_obj_t *)var;
    if (!g_menu || page != g_menu->page_obj) return;

    /* value: 0..LV_SCALE_NONE (ease-out → decelerates). */
    int32_t tgt_x = g_menu->throw_base.x +
                    (int32_t)(((int64_t)g_menu->throw_total.x * value) / LV_SCALE_NONE);
    int32_t tgt_y = g_menu->throw_base.y +
                    (int32_t)(((int64_t)g_menu->throw_total.y * value) / LV_SCALE_NONE);
    /* Vertical: the X axis belongs to the spring-return (honeycomb_fx_tick),
     * so the throw must not fight it — it only drives Y.  Hex keeps 2D. */
    int32_t dx = (g_layout_mode == HONEYCOMB_MODE_VERTICAL_GRID) ? 0
                : lv_obj_get_scroll_x(page) - tgt_x;
    int32_t dy = lv_obj_get_scroll_y(page) - tgt_y;
    if (dx != 0 || dy != 0) {
        lv_obj_scroll_by(page, dx, dy, LV_ANIM_OFF);
        honeycomb_transform(false);
    }
}

static void honeycomb_momentum_anim_done(lv_anim_t *a)
{
    (void)a;
    if (!g_menu) return;
    g_menu->throw_active = false;
    /* Snap: settle onto the icon nearest the glide's landing point.  Do NOT
     * set anim_obj here — the arrival scroll must centre the icon without
     * selecting/launching it. */
    lv_obj_t *focus = honeycomb_predict_landing_icon();
    if (focus) honeycomb_scroll_icon_to_center(focus, true);
}

/* Estimate the release velocity (px/sec) from the recent scroll samples. */
static void honeycomb_compute_velocity(void)
{
    g_menu->scroll_vel.x = 0;
    g_menu->scroll_vel.y = 0;
    if (g_menu->vel_count == 0) return;

    int newest = (g_menu->vel_idx - 1 + VEL_SAMPLES) % VEL_SAMPLES;
    int64_t t1 = g_menu->vel_time[newest];
    int32_t x1 = g_menu->vel_pos[newest][0];
    int32_t y1 = g_menu->vel_pos[newest][1];

    /* If the scroll stopped moving long ago (slow frame or a dwell), don't glide. */
    if ((esp_timer_get_time() - t1) > VEL_STALE_US) return;

    int32_t x0 = x1, y0 = y1;
    int64_t t0 = t1;
    for (int k = 0; k < g_menu->vel_count; k++) {
        int idx = (newest - k + VEL_SAMPLES) % VEL_SAMPLES;
        if ((t1 - g_menu->vel_time[idx]) > VEL_WINDOW_US) break;
        x0 = g_menu->vel_pos[idx][0];
        y0 = g_menu->vel_pos[idx][1];
        t0 = g_menu->vel_time[idx];
    }

    int64_t dt = t1 - t0;
    if (dt < 20000) dt = 20000;   /* min 20 ms — avoid division blow-ups */
    g_menu->scroll_vel.x = (int32_t)((int64_t)(x1 - x0) * 1000000 / dt);
    g_menu->scroll_vel.y = (int32_t)((int64_t)(y1 - y0) * 1000000 / dt);
}

static void honeycomb_start_momentum(void)
{
    lv_obj_t *page = g_menu->page_obj;
    g_menu->throw_base.x  = lv_obj_get_scroll_x(page);
    g_menu->throw_base.y  = lv_obj_get_scroll_y(page);

    int32_t vx = g_menu->scroll_vel.x;
    int32_t vy = g_menu->scroll_vel.y;
    if (g_layout_mode == HONEYCOMB_MODE_VERTICAL_GRID) vx = 0;

    /* Glide duration grows with the release velocity.  With the parabola path
     * (2u−u²) the motion starts EXACTLY at the measured velocity v0 and
     * decelerates smoothly (constant deceleration) to a stop, covering
     * v0·T/2 px — no ease-out "kick" above v0 and no sudden braking. */
    int32_t vmax = LV_MAX(LV_ABS(vx), LV_ABS(vy));
    int32_t t_ms = (vmax * 1000) / THROW_DECEL;
    if (t_ms < 60)  t_ms = 60;
    if (t_ms > THROW_MS) t_ms = THROW_MS;

    g_menu->throw_total.x = honeycomb_throw_axis(vx, t_ms);
    g_menu->throw_total.y = honeycomb_throw_axis(vy, t_ms);

    g_menu->throw_active = true;
    lv_anim_t a;
    lv_anim_init(&a);
    lv_anim_set_var(&a, page);
    lv_anim_set_exec_cb(&a, honeycomb_momentum_anim_cb);
    lv_anim_set_values(&a, 0, LV_SCALE_NONE);
    lv_anim_set_time(&a, t_ms);
    lv_anim_set_path_cb(&a, honeycomb_parabola_path);
    lv_anim_set_completed_cb(&a, honeycomb_momentum_anim_done);
    lv_anim_start(&a);
}

static void page_event_cb(lv_event_t *e)
{
    /* The menu may have been torn down already (destroy() deletes the scroll
     * animation, which makes LVGL fire SCROLL_END synchronously). */
    if (!g_menu) return;

    lv_event_code_t code = lv_event_get_code(e);

    switch (code) {
    case LV_EVENT_PRESSED:
        g_menu->anim_obj = NULL;
        g_menu->throw_active = false;   /* a new touch cancels any glide */
        g_menu->gesture_moved = false;  /* fresh press: no drag yet */
        g_menu->vel_count = 0;          /* reset velocity history for the new drag */
        g_menu->vel_idx = 0;
        g_menu->scroll_vel.x = 0;
        g_menu->scroll_vel.y = 0;
        lv_obj_remove_flag(g_menu->page_obj, LV_OBJ_FLAG_SCROLLABLE);
        lv_anim_delete(g_menu->page_obj, NULL);

        /* Touch attraction: remember the press point and repaint so the
         * surrounding icons visibly shift toward it. */
        g_menu->touch_active = true;
        {
            lv_indev_t *indev = lv_indev_active();
            if (indev) lv_indev_get_point(indev, &g_menu->touch_point);
        }
        lv_obj_invalidate(g_menu->page_obj);
        break;

    case LV_EVENT_RELEASED:
        lv_obj_add_flag(g_menu->page_obj, LV_OBJ_FLAG_SCROLLABLE);
        if (g_menu->scroll_active) {
            honeycomb_compute_velocity();
            int32_t speed = (g_layout_mode == HONEYCOMB_MODE_VERTICAL_GRID)
                                ? LV_ABS(g_menu->scroll_vel.y)
                                : LV_MAX(LV_ABS(g_menu->scroll_vel.x), LV_ABS(g_menu->scroll_vel.y));
            if (speed >= THROW_MIN_VEL) {
                /* Keep scrolling with the release velocity (energy-conserved),
                 * then snap at the end of the glide. */
                honeycomb_start_momentum();
            } else {
                /* Too slow to glide — settle straight onto the nearest icon. */
                lv_obj_t *focus = honeycomb_predict_landing_icon();
                if (focus) honeycomb_scroll_icon_to_center(focus, true);
            }
        }
        g_menu->scroll_active = false;
        g_menu->scroll_sum.x = 0;
        g_menu->scroll_sum.y = 0;
        g_menu->touch_active = false;   /* finger lifted — attraction fades */
        break;

    case LV_EVENT_PRESS_LOST:
    case LV_EVENT_CLICKED:
        lv_obj_add_flag(g_menu->page_obj, LV_OBJ_FLAG_SCROLLABLE);
        g_menu->scroll_active = false;
        g_menu->scroll_sum.x = 0;
        g_menu->scroll_sum.y = 0;
        g_menu->touch_active = false;
        break;

    case LV_EVENT_PRESSING: {
        lv_indev_t *indev = lv_indev_active();
        lv_point_t p;
        lv_indev_get_vect(indev, &p);

        /* Vertical is NOT Y-only: horizontal motion is allowed too (the
         * spring in honeycomb_fx_tick returns it to centre). */
        g_menu->scroll_sum.x += p.x;
        g_menu->scroll_sum.y += p.y;

        /* Track the live touch point so icons follow/lean toward it. */
        g_menu->touch_active = true;
        lv_indev_get_point(indev, &g_menu->touch_point);

        const uint8_t scroll_limit = 10;
        int32_t abs_sum = LV_MAX(LV_ABS(g_menu->scroll_sum.x),
                                 LV_ABS(g_menu->scroll_sum.y));
        if (abs_sum > scroll_limit || g_menu->scroll_active) {
            g_menu->scroll_active = true;
            g_menu->gesture_moved = true;
            lv_obj_invalidate(g_menu->page_obj);
        }
        if (g_menu->scroll_active) honeycomb_vel_sample(g_menu->page_obj);
        break;
    }

    case LV_EVENT_SCROLL:
        honeycomb_transform(false);
        break;

    case LV_EVENT_SCROLL_END:
        /* Debug: report the vertical scroll when it settles (not mid-drag,
         * during a glide, or while the X spring is still returning). */
        if (g_menu && g_layout_mode == HONEYCOMB_MODE_VERTICAL_GRID &&
            !g_menu->scroll_active && !g_menu->throw_active &&
            !g_menu->spring_active) {
            honeycomb_vert_debug_log("settled");
        }
        if (g_menu->anim_obj && !g_menu->throw_active &&
            !g_menu->spring_active) {
            g_menu->anim_obj = NULL;
            if (g_pending_settings || g_pending_photos ||
                g_pending_calculator || g_pending_noise ||
                g_pending_activity || g_pending_jsapps || g_pending_jsapp >= 0) {
                ESP_LOGI(TAG, "Icon selected (app) — closing menu");
            } else {
                ESP_LOGI(TAG, "Icon selected — returning to watch face");
            }
            honeycomb_menu_destroy();
        }
        break;

    default:
        break;
    }
}

static void icon_event_cb(lv_event_t *e)
{
    if (!g_menu) return;

    lv_event_code_t code = lv_event_get_code(e);

    /* Long-press on an icon (distinct-icons mode only) enters rearrange
     * mode.  A real drag/scroll sets gesture_moved/scroll_active, so those
     * gestures must NOT trigger it — only a still hold does.  The flag is
     * serviced by the main loop, which waits for the finger to lift before
     * tearing the menu down (destroying the pressed object mid-gesture would
     * leave LVGL's indev pointing at freed memory). */
    if (code == LV_EVENT_LONG_PRESSED && g_distinct_icons &&
        !g_menu->gesture_moved && !g_menu->scroll_active && !g_menu->throw_active) {
        ESP_LOGI(TAG, "Icon long-pressed — entering rearrange mode");
        g_pending_rearrange = true;
        return;
    }

    /* IMPORTANT: do NOT stop bubbling on RELEASED here.  The release must
     * reach the page so the momentum glide starts even when the drag began
     * on an icon.  Also note that because the page's SCROLLABLE flag is
     * removed during the press, LVGL will send SHORT_CLICKED even after a
     * large drag — so a click is only accepted when THIS press never dragged
     * (gesture_moved) and no glide is running (throw_active). */
    if (code == LV_EVENT_SHORT_CLICKED &&
        !g_menu->gesture_moved && !g_menu->scroll_active && !g_menu->throw_active) {
        lv_obj_t *obj = lv_event_get_current_target(e);
        ESP_LOGI(TAG, "Icon clicked!");

        /* Check which icon was clicked (the picture lives in the
         * container's child image). */
        const void *src = NULL;
        lv_obj_t *img = lv_obj_get_child(obj, 0);
        if (img) src = lv_image_get_src(img);
        if (src == &settings_96) {
            ESP_LOGI(TAG, "Settings icon selected — launching settings UI");
            g_pending_settings = true;
        } else if (src == &photos_96) {
            ESP_LOGI(TAG, "Photos icon selected — launching photos UI");
            g_pending_photos = true;
        } else if (src == &calculator_96) {
            ESP_LOGI(TAG, "Calculator icon selected — launching calculator UI");
            g_pending_calculator = true;
        } else if (src == &Noise_96) {
            ESP_LOGI(TAG, "Noise icon selected — launching noise UI");
            g_pending_noise = true;
        } else if (src == &Activity_96) {
            ESP_LOGI(TAG, "Activity icon selected — launching activity UI");
            g_pending_activity = true;
        } else if (src == &app_store_96) {
            ESP_LOGI(TAG, "App Store icon selected — opening JS app launcher");
            g_pending_jsapps = true;
        } else if (s_jsapp_icon && src == s_jsapp_icon) {
            ESP_LOGI(TAG, "JS app icon selected — launching directly");
            g_pending_jsapp = s_jsapp_index;
        }

        lv_obj_add_flag(g_menu->page_obj, LV_OBJ_FLAG_SCROLLABLE);
        if (honeycomb_scroll_icon_to_center(obj, true)) {
            /* Icon will glide to centre — launch when the arrival scroll
             * animation ends (SCROLL_END). */
            g_menu->anim_obj = obj;
        } else {
            /* Icon is already centred, so no scroll animation runs and
             * SCROLL_END never fires — launch immediately. */
            g_menu->anim_obj = NULL;
            if (g_pending_settings || g_pending_photos ||
                g_pending_calculator || g_pending_noise ||
                g_pending_activity || g_pending_jsapps || g_pending_jsapp >= 0) {
                ESP_LOGI(TAG, "Icon selected (app) — closing menu");
            } else {
                ESP_LOGI(TAG, "Icon selected — returning to watch face");
            }
            honeycomb_menu_destroy();
        }
    }
}

/*============================================================================
 * Populate Icons
 *============================================================================*/

static void honeycomb_populate_icons(lv_obj_t *page)
{
    int total_icons = g_distinct_icons ? (int)ICON_COUNT : g_icon_count;

    for (int i = 0; i < total_icons; i++) {
        uint16_t col, row;
        layout_get_icon_col_row_by_idx((uint16_t)i, &col, &row);

        /* Distinct mode honours the persisted rearrange order; filled mode
         * keeps cycling through the icon set. */
        int icon_idx = g_distinct_icons ? g_config.honeycomb_icon_order[i]
                                        : (i % ICON_COUNT);

        /* Each icon lives in a CLIP CONTAINER (the page child).  The
         * container carries the position + the temporary circular clip;
         * the inner lv_image carries the picture + the zoom.  clip_corner
         * only cuts in during the entry animation (it renders the child
         * into an ARGB8888 layer — too expensive to keep on for the whole
         * menu), so the normal menu stays as fast square images. */
        lv_obj_t *container = lv_obj_create(page);
        lv_obj_remove_flag(container, LV_OBJ_FLAG_SCROLLABLE);
        lv_obj_add_flag(container, LV_OBJ_FLAG_CLICKABLE |
                                   LV_OBJ_FLAG_EVENT_BUBBLE |
                                   LV_OBJ_FLAG_PRESS_LOCK);
        lv_obj_set_size(container, ICON_OUTER_DIAMETER, ICON_OUTER_DIAMETER);
        lv_obj_set_style_bg_opa(container, LV_OPA_TRANSP, 0);
        lv_obj_set_style_border_width(container, 0, 0);
        lv_obj_set_style_pad_all(container, 0, 0);
        lv_obj_set_style_radius(container, 0, 0);          /* circle off by default */
        lv_obj_set_style_clip_corner(container, false, 0); /* no layer cost normally */
        lv_obj_add_event_cb(container, icon_event_cb, LV_EVENT_ALL, NULL);

        lv_obj_t *icon = lv_image_create(container);
        lv_image_set_src(icon, honeycomb_menu_icon_dsc(icon_idx));
        lv_image_set_antialias(icon, false);
        lv_obj_center(icon);
        lv_obj_remove_flag(icon, LV_OBJ_FLAG_SCROLLABLE);

        /* Entry animation enabled for the current layout: start each icon
         * invisible so it can pop/fade in.  (Hex and vertical each have
         * their own toggle.) */
        bool entry_on = (g_layout_mode == HONEYCOMB_MODE_VERTICAL_GRID)
                            ? g_config.honeycomb_vertical_entry_animation
                            : g_config.honeycomb_hex_entry_animation;
        if (entry_on) {
            lv_obj_set_style_opa(container, LV_OPA_TRANSP, 0);
        }

        *honeycomb_get_icon_obj(row, col) = container;
    }

    ESP_LOGI(TAG, "Populated %d icons (%s, PNGs)", total_icons,
             g_distinct_icons ? "distinct" : "filled");
}

/*============================================================================
 * UI Init
 *============================================================================*/

static void vertical_icon_enter_anim_cb(void *obj, int32_t value)
{
    lv_obj_set_style_opa((lv_obj_t *)obj, value, 0);
}

/* Circle-pop driver: zooms the image (inline lv_image_set_scale — no
 * transform layer).  The icon data is a baked circular RGB565A8 image, so
 * the circle scales along with the zoom automatically (no clip needed). */
static void vertical_icon_scale_anim_cb(void *obj, int32_t value)
{
    lv_image_set_scale((lv_obj_t *)obj, (uint32_t)value);
}

/* Jelly rise driver: animates the icon's Y so it rises from below the
 * screen into its slot, overshooting a little past the slot and snapping
 * back. */
static void vertical_icon_pos_anim_cb(void *obj, int32_t value)
{
    lv_obj_set_y((lv_obj_t *)obj, value);
}

/* Jelly move driver for the X axis (hex "big circle closes" entry). */
static void vertical_icon_pos_x_anim_cb(void *obj, int32_t value)
{
    lv_obj_set_x((lv_obj_t *)obj, value);
}

/* Shared scale-pop + fade start for an in-window entry icon (the clip
 * container).  The caller adds the layout-specific position animation. */
static void honeycomb_icon_start_scale_fade(lv_obj_t *con)
{
    lv_obj_t *img = lv_obj_get_child(con, 0);
    if (!img) return;

    /* Jelly pop: zoom the IMAGE itself (inline, no transform layer) from a
     * dot to its fisheye size.  The image is a baked circular RGB565A8, so
     * the circle grows with the zoom automatically. */
    int32_t target = lv_image_get_scale(img);
    if (target < 16) target = 16;
    lv_image_set_scale(img, 1);          /* start from a dot */

    lv_anim_t a;
    lv_anim_init(&a);
    lv_anim_set_var(&a, img);
    lv_anim_set_exec_cb(&a, vertical_icon_scale_anim_cb);
    lv_anim_set_values(&a, 1, target);    /* overshoot → jelly pop */
    lv_anim_set_time(&a, 260);
    lv_anim_set_path_cb(&a, lv_anim_path_overshoot);
    lv_anim_start(&a);

    /* Fade in alongside the scale so the icon never shows as a dot. */
    lv_anim_init(&a);
    lv_anim_set_var(&a, con);
    lv_anim_set_exec_cb(&a, vertical_icon_enter_anim_cb);
    lv_anim_set_values(&a, LV_OPA_TRANSP, LV_OPA_COVER);
    lv_anim_set_time(&a, 200);
    lv_anim_set_path_cb(&a, lv_anim_path_ease_out);
    lv_anim_start(&a);
}

static int honeycomb_get_vertical_row_count(int total_icons)
{
    int row = 0;
    int remaining = total_icons;

    while (remaining > 0) {
        int icons_in_row = (row % 2 == 0) ? VERT_ICONS_PER_ROW_EVEN : VERT_ICONS_PER_ROW_ODD;
        remaining -= icons_in_row;
        if (remaining > 0) row++;
    }
    return row;
}

/* 0-indexed row the vertical menu opens on (user wants row 2), clamped to
 * the last populated row so a small icon set never opens empty. */
static int honeycomb_vertical_entry_row(int total_icons)
{
    int last_row = honeycomb_get_vertical_row_count(total_icons);
    return (2 < last_row) ? 2 : last_row;
}

/* First icon object in the vertical entry row — used to set center_icon. */
static lv_obj_t *honeycomb_vertical_entry_icon(int total_icons)
{
    int center_row = honeycomb_vertical_entry_row(total_icons);
    int idx = 0;
    for (int r = 0; r < center_row; r++) {
        idx += (r % 2 == 0) ? VERT_ICONS_PER_ROW_EVEN : VERT_ICONS_PER_ROW_ODD;
    }
    uint16_t col, row;
    layout_get_icon_col_row_by_idx((uint16_t)idx, &col, &row);
    return *honeycomb_get_icon_obj(row, col);
}

/* Log the current vertical scroll + the row at screen centre.  Scroll the
 * menu where you want it to open, then the "settled" line in the log gives
 * the exact scroll value to hard-code as the initial position. */
static void honeycomb_vert_debug_log(const char *why)
{
    if (g_layout_mode != HONEYCOMB_MODE_VERTICAL_GRID || !g_menu || !g_menu->page_obj) return;
    int32_t sx = lv_obj_get_scroll_x(g_menu->page_obj);
    int32_t sy = lv_obj_get_scroll_y(g_menu->page_obj);
    /* Row whose pivot sits at screen centre:
     *   row = (LCD_V_RES/2 + scroll_y - VERT_TOP_PADDING - ICON_OUTER_RADIUS) / VERT_ROW_HEIGHT */
    int center_row = (LCD_V_RES / 2 + sy - VERT_TOP_PADDING - ICON_OUTER_RADIUS
                      + (VERT_ROW_HEIGHT / 2)) / VERT_ROW_HEIGHT;
    ESP_LOGI(TAG, "VERT[%s] scroll=(%ld,%ld) center_row=%d",
             why, (long)sx, (long)sy, center_row);
}

/* True when the icon at (row, col) is at least partially inside the current
 * viewport.  honeycomb_transform() leaves the icon pivots in screen space
 * (raw grid position minus scroll, BEFORE the fisheye clamp), so a simple
 * AABB-vs-screen test tells us which icons are actually visible.
 *
 * Only icons inside the window should get the entry pop-in animation —
 * animating every icon, most of which sit far off-screen, is what spikes
 * the render load and crashes the S3 on large icon sets. */
static bool honeycomb_icon_in_window(uint16_t col, uint16_t row)
{
    lv_point_t *p = honeycomb_get_icon_pivot(row, col);
    if (!p) return false;

    int32_t x0 = p->x - (ICON_IMG_WIDTH  >> 1);
    int32_t y0 = p->y - (ICON_IMG_HEIGHT >> 1);
    int32_t x1 = p->x + (ICON_IMG_WIDTH  >> 1);
    int32_t y1 = p->y + (ICON_IMG_HEIGHT >> 1);

    return (x1 >= 0 && x0 < LCD_H_RES &&
            y1 >= 0 && y0 < LCD_V_RES);
}

/* True when at least one icon of `row` is visible in the viewport. */
static bool honeycomb_row_in_window(int row, int total_icons)
{
    for (int idx = 0; idx < total_icons; idx++) {
        uint16_t col, r;
        layout_get_icon_col_row_by_idx((uint16_t)idx, &col, &r);
        if ((int)r != row) continue;
        if (honeycomb_icon_in_window(col, r)) return true;
    }
    return false;
}

static void honeycomb_vertical_enter_anim_step(lv_timer_t *timer)
{
    int target_row = (int)(uintptr_t)lv_timer_get_user_data(timer);

    /* One-shot timer (repeat_count=1) that frees itself when it fires.
     * Null its slot in the array BEFORE freeing so honeycomb_menu_destroy()
     * never calls lv_timer_delete() on an already-freed pointer — that
     * double-free is what made the animation only work once before the S3
     * crashed on menu close/reopen. */
    if (g_menu) {
        for (int i = 0; i < g_menu->entry_timer_count; i++) {
            if (g_menu->entry_timers[i] == timer) {
                g_menu->entry_timers[i] = NULL;
                break;
            }
        }
    }
    lv_timer_delete(timer);

    if (!g_menu || g_layout_mode != HONEYCOMB_MODE_VERTICAL_GRID) return;

    int total_icons = g_distinct_icons ? ICON_COUNT : g_icon_count;
    for (int idx = 0; idx < total_icons; idx++) {
        uint16_t col, row;
        layout_get_icon_col_row_by_idx((uint16_t)idx, &col, &row);
        if ((int)row != target_row) continue;

        lv_obj_t *con = *honeycomb_get_icon_obj(row, col);
        if (!con) continue;

        if (!honeycomb_icon_in_window(col, row)) {
            /* No longer in view (menu was scrolled during the pop-in) —
             * leave it fully visible instead of hidden at opacity 0. */
            lv_obj_set_style_opa(con, LV_OPA_COVER, 0);
            continue;
        }

        /* Rise from below the screen into its slot, overshooting a little
         * past the slot and snapping back (position jelly), while the scale
         * pop + fade run at the same time. */
        int32_t final_y = lv_obj_get_y(con);
        int32_t start_y = final_y + LCD_V_RES;
        lv_obj_set_y(con, start_y);

        honeycomb_icon_start_scale_fade(con);

        lv_anim_t a;
        lv_anim_init(&a);
        lv_anim_set_var(&a, con);
        lv_anim_set_exec_cb(&a, vertical_icon_pos_anim_cb);
        lv_anim_set_values(&a, start_y, final_y);  /* overshoot → snap back */
        lv_anim_set_time(&a, 320);
        lv_anim_set_path_cb(&a, lv_anim_path_overshoot);
        lv_anim_start(&a);
    }
}

/* Hex-spiral ring of a linear icon index (mirrors the spiral layout). */
static int honeycomb_hex_ring_of_idx(int idx)
{
    if (idx <= 0) return 0;
    int total = 0, ring = 0, ring_icons = 1;
    while (total + ring_icons - 1 < idx) {
        total += ring_icons;
        ring++;
        ring_icons = ring * 6;
    }
    return ring;
}

/* One-shot at the end of the entry animation: ensure every container is
 * fully opaque, then re-apply the normal fisheye sizes (the animation kept
 * the images mid-scale).  The circular look is baked into the icon data, so
 * nothing needs removing. */
static void honeycomb_entry_anim_done_cb(lv_timer_t *timer)
{
    lv_timer_delete(timer);
    if (!g_menu || !g_menu->page_obj) return;
    int total = g_distinct_icons ? ICON_COUNT : g_icon_count;
    for (int idx = 0; idx < total; idx++) {
        uint16_t col, row;
        layout_get_icon_col_row_by_idx((uint16_t)idx, &col, &row);
        lv_obj_t *con = *honeycomb_get_icon_obj(row, col);
        if (con) lv_obj_set_style_opa(con, LV_OPA_COVER, 0);
    }
    honeycomb_transform(true);
    lv_obj_invalidate(g_menu->page_obj);
}

/* Hex entry animation: every icon scales up AND moves in from the outer
 * ring (ring 4) along the ray from the centre through its own slot, in the
 * shortest (straight) line, rings collapsing in order 1 → 2 → 3 → 4.  One
 * timer per ring, inner ring first. */
static void honeycomb_hex_enter_anim_step(lv_timer_t *timer)
{
    int ring = (int)(uintptr_t)lv_timer_get_user_data(timer);

    /* One-shot timer — null its slot before freeing (see vertical step). */
    if (g_menu) {
        for (int i = 0; i < g_menu->entry_timer_count; i++) {
            if (g_menu->entry_timers[i] == timer) {
                g_menu->entry_timers[i] = NULL;
                break;
            }
        }
    }
    lv_timer_delete(timer);

    if (!g_menu || g_layout_mode != HONEYCOMB_MODE_HEX_SPIRAL) return;

    int total_icons = g_distinct_icons ? ICON_COUNT : g_icon_count;
    const int32_t cx = LCD_H_RES >> 1;
    const int32_t cy = LCD_V_RES >> 1;
    /* The outer ring's radius — every moving icon starts stacked here. */
    int max_ring = honeycomb_hex_ring_of_idx(total_icons - 1);
    const int32_t outer_r = max_ring * ICON_OUTER_RADIUS;

    for (int idx = 0; idx < total_icons; idx++) {
        if (honeycomb_hex_ring_of_idx(idx) != ring) continue;

        uint16_t col, row;
        layout_get_icon_col_row_by_idx((uint16_t)idx, &col, &row);
        lv_obj_t *con = *honeycomb_get_icon_obj(row, col);
        if (!con) continue;

        if (!honeycomb_icon_in_window(col, row)) {
            /* Off-screen ring icons appear instantly — animating far
             * off-screen icons is what spiked the draw threads before. */
            lv_obj_set_style_opa(con, LV_OPA_COVER, 0);
            continue;
        }

        /* Scale pop + fade (shared with the vertical entry). */
        honeycomb_icon_start_scale_fade(con);

        /* Index 0 is the centre icon — it only scales, it doesn't move. */
        if (idx == 0) continue;

        /* Start stacked on the OUTER ring (ring 4) along the ray from the
         * screen centre through this icon's own slot, then fly in toward
         * the centre along that ray — the shortest (straight) path to its
         * position.  Icons directly left/right move purely horizontally,
         * directly above/below purely vertically, corners diagonally. */
        int32_t cx0 = lv_obj_get_x(con) + (ICON_OUTER_DIAMETER >> 1);
        int32_t cy0 = lv_obj_get_y(con) + (ICON_OUTER_DIAMETER >> 1);
        int32_t ddx = cx0 - cx, ddy = cy0 - cy;
        int32_t dist = isqrt32(ddx * ddx + ddy * ddy);
        if (dist < 1) dist = 1;
        int32_t big_r = outer_r;                          /* ring 4 */
        int32_t fx = lv_obj_get_x(con);
        int32_t fy = lv_obj_get_y(con);
        int32_t sx = cx + (int32_t)(((int64_t)ddx * big_r) / dist) - (ICON_OUTER_DIAMETER >> 1);
        int32_t sy = cy + (int32_t)(((int64_t)ddy * big_r) / dist) - (ICON_OUTER_DIAMETER >> 1);
        lv_obj_set_pos(con, sx, sy);

        lv_anim_t a;
        lv_anim_init(&a);
        lv_anim_set_var(&a, con);
        lv_anim_set_exec_cb(&a, vertical_icon_pos_x_anim_cb);
        lv_anim_set_values(&a, sx, fx);
        lv_anim_set_time(&a, 320);
        lv_anim_set_path_cb(&a, lv_anim_path_overshoot);
        lv_anim_start(&a);

        lv_anim_init(&a);
        lv_anim_set_var(&a, con);
        lv_anim_set_exec_cb(&a, vertical_icon_pos_anim_cb);
        lv_anim_set_values(&a, sy, fy);
        lv_anim_set_time(&a, 320);
        lv_anim_set_path_cb(&a, lv_anim_path_overshoot);
        lv_anim_start(&a);
    }
}

static void honeycomb_ui_init(void)
{
    lv_obj_t *page = lv_obj_create(lv_screen_active());
    lv_obj_set_style_bg_color(page, lv_color_black(), LV_PART_MAIN);
    lv_obj_set_style_border_width(page, 0, LV_PART_MAIN);
    /* Icons are positioned with absolute coordinates in page space.  The
     * theme's default 16 px padding shifts the whole grid right/down and
     * pushes the outer column past the right edge of the 410 px panel. */
    lv_obj_set_style_pad_all(page, 0, LV_PART_MAIN);

    /* Page = viewport (screen size). Icons are positioned beyond it,
     * creating the scrollable overflow area. */
    lv_obj_set_size(page, LCD_H_RES, LCD_V_RES);
    lv_obj_set_pos(page, 0, 0);

    if (g_layout_mode == HONEYCOMB_MODE_VERTICAL_GRID) {
        /* Vertical-only scrolling with snap on Y axis */
        lv_obj_set_scroll_snap_y(page, LV_SCROLL_SNAP_CENTER);
    } else {
        lv_obj_set_scroll_snap_x(page, LV_SCROLL_SNAP_CENTER);
        lv_obj_set_scroll_snap_y(page, LV_SCROLL_SNAP_CENTER);
    }

    lv_obj_add_flag(page, LV_OBJ_FLAG_SCROLLABLE);
    lv_obj_set_scroll_dir(page,
        (g_layout_mode == HONEYCOMB_MODE_VERTICAL_GRID) ? LV_DIR_VER : LV_DIR_ALL);
    lv_obj_set_scrollbar_mode(page, LV_SCROLLBAR_MODE_OFF);
    lv_obj_add_event_cb(page, page_event_cb, LV_EVENT_ALL, NULL);

    g_menu->page_obj = page;

    /* 20ms driver for the vertical X spring-return and the touch-attraction
     * fade.  Created once (repeats forever), deleted on destroy. */
    g_menu->fx_timer = lv_timer_create(honeycomb_fx_tick, 20, NULL);

    lv_display_add_event_cb(lv_display_get_default(), refr_start_cb,
                             LV_EVENT_REFR_START, NULL);
}

/*============================================================================
 * Delayed Refresh Timer
 *============================================================================*/

static void delayed_refresh_cb(lv_timer_t *timer)
{
    if (g_menu && g_menu->page_obj) {
        honeycomb_transform(true);
        /* No scroll re-snap here on purpose.  honeycomb_menu_create already
         * leaves the menu at the correct scroll position; re-snapping at
         * 50/100/250/500/1000ms is what yanked the view back to centre a
         * second after entry (hex) and forced the vertical grid from row 2
         * to row 3.  The transform + invalidate below is all that's needed
         * to catch up after async PNG decode. */
        lv_obj_invalidate(g_menu->page_obj);
    }
    lv_timer_delete(timer);
}

/*============================================================================
 * Public API
 *============================================================================*/

void honeycomb_menu_set_layout_mode(honeycomb_layout_mode_t mode)
{
    g_layout_mode = mode;
    ESP_LOGI(TAG, "Layout mode set to: %s",
             mode == HONEYCOMB_MODE_VERTICAL_GRID ? "vertical" : "spiral");
}

honeycomb_layout_mode_t honeycomb_menu_get_layout_mode(void)
{
    return g_layout_mode;
}

/*============================================================================
 * Full-screen fade — backlight driven (no per-pixel blending)
 *============================================================================*/

static void honeycomb_brightness_ramp(uint8_t target, int step_ms)
{
    int cur = (int)hw_display_get_brightness();
    if (cur == (int)target) return;
    int step = (cur < (int)target) ? 3 : -3;
    while (cur != (int)target) {
        cur += step;
        if ((step > 0 && cur > (int)target) || (step < 0 && cur < (int)target)) {
            cur = (int)target;
        }
        hw_display_set_brightness((uint8_t)cur);
        if (step_ms > 0) vTaskDelay(pdMS_TO_TICKS(step_ms));
    }
}

void honeycomb_menu_fade_in(void)
{
    honeycomb_brightness_ramp(g_brightness, 6);
}

void honeycomb_menu_create(void)
{
    ESP_LOGI(TAG, "Creating honeycomb menu (mode=%s)...",
             g_layout_mode == HONEYCOMB_MODE_VERTICAL_GRID ? "vertical" : "spiral");

    /* Start dark so the menu fades in via the backlight. */
    hw_display_set_brightness(0);

    g_menu = (honeycomb_menu_t *)heap_caps_calloc(1, sizeof(honeycomb_menu_t), MALLOC_CAP_SPIRAM);
    if (!g_menu) { ESP_LOGE(TAG, "OOM menu"); return; }

    g_menu->zoom = 1.0f;
    g_menu->target_zoom = 1.0f;

    uint16_t max_icons = MAX_APP_COL_NUM * MAX_APP_ROW_NUM;
    g_menu->icon_list  = (lv_obj_t **)heap_caps_calloc(max_icons, sizeof(lv_obj_t *), MALLOC_CAP_SPIRAM);
    g_menu->icon_pivot = (lv_point_t *)heap_caps_calloc(max_icons, sizeof(lv_point_t), MALLOC_CAP_SPIRAM);

    if (!g_menu->icon_list || !g_menu->icon_pivot) {
        ESP_LOGE(TAG, "OOM arrays");
        heap_caps_free(g_menu->icon_list);
        heap_caps_free(g_menu->icon_pivot);
        heap_caps_free(g_menu);
        g_menu = NULL;
        return;
    }

    /* Sync runtime toggles from persistent config */
    g_distinct_icons     = g_config.honeycomb_distinct_icons;
    g_layout_mode        = (g_config.honeycomb_layout_mode == 1)
                              ? HONEYCOMB_MODE_VERTICAL_GRID
                              : HONEYCOMB_MODE_HEX_SPIRAL;

    /* Refresh the SD-card app registry so installed JS apps appear in the
     * launcher (the decorative "calendar" slot shows the first app icon). */
    js_app_registry_scan();
    s_jsapp_icon = NULL;
    s_jsapp_index = -1;
    if (js_app_registry_count() > 0) {
        const js_app_entry_t *e = js_app_registry_get(0);
        if (e && e->icon) {
            s_jsapp_icon = e->icon;
            s_jsapp_index = 0;
        }
    }

    honeycomb_ui_init();
    honeycomb_populate_icons(g_menu->page_obj);
    honeycomb_coord_init();

    /* CRITICAL: For vertical grid, the C0R0 anchor must match the
     * actual pivot(0,0) so honeycomb_transform doesn't shift the
     * entire grid off-screen. Hex-spiral defaults are already correct. */
    if (g_layout_mode == HONEYCOMB_MODE_VERTICAL_GRID) {
        g_c0r0_x = honeycomb_get_icon_pivot(0, 0)->x;
        g_c0r0_y = honeycomb_get_icon_pivot(0, 0)->y;
    }

    /* Pre-select the center hex icon so the initial snap can use it.
     * This prevents the first render from showing an empty or off-center view. */
    if (g_layout_mode != HONEYCOMB_MODE_VERTICAL_GRID) {
        uint16_t col, row;
        layout_get_icon_col_row_by_idx(0, &col, &row);
        g_menu->center_icon = *honeycomb_get_icon_obj(row, col);
    }

    /* Compute initial scroll so the grid centre lands on screen centre.
     * Vertical grid: open on 0-indexed row 2 (user preference), clamped to
     * the last populated row.  Hex spiral: open on icon 0 (the centre). */
    int32_t scroll_to_x, scroll_to_y;
    if (g_layout_mode == HONEYCOMB_MODE_VERTICAL_GRID) {
        int total_icons = g_distinct_icons ? ICON_COUNT : g_icon_count;
        int center_row = honeycomb_vertical_entry_row(total_icons);
        int last_row   = honeycomb_get_vertical_row_count(total_icons);
        int32_t cy = VERT_TOP_PADDING
                   + (center_row * VERT_ROW_HEIGHT)
                   + ICON_OUTER_RADIUS;
        scroll_to_x = 0;  /* icons already horizontally centered */
        /* NOTE: lv_obj_get_scroll_y() returns the NEGATED stored scroll, so
         * to land on the logged opening position scroll=(0,104) (= center_row
         * 2) the scroll_by delta must be the NEGATIVE of the usual pivot
         * centre math.  Verified via the VERT debug logs. */
        scroll_to_y = (LCD_V_RES >> 1) - cy;
        ESP_LOGI(TAG, "VERT create: total=%d rows=%d entry_row=%d pivot_y=%ld scroll_to_y=%ld",
                 total_icons, last_row, center_row, (long)cy, (long)scroll_to_y);
    } else {
        uint16_t col, row;
        layout_get_icon_col_row_by_idx(0, &col, &row);
        int32_t cx = honeycomb_get_icon_pivot(row, col)->x;
        int32_t cy = honeycomb_get_icon_pivot(row, col)->y;
        scroll_to_x = cx - (LCD_H_RES >> 1);
        scroll_to_y = cy - (LCD_V_RES >> 1);
    }
    lv_obj_scroll_by(g_menu->page_obj, scroll_to_x, scroll_to_y, LV_ANIM_OFF);
    honeycomb_vert_debug_log("create");

    /* Compute the icons' final layout sizes BEFORE the first transform.
     * Otherwise lv_obj_get_width() can still be 0, the fisheye scale is
     * skipped, and the icons render at their raw size for the first few
     * frames after entering the menu. */
    lv_obj_update_layout(g_menu->page_obj);
    honeycomb_transform(true);
    /* Hex only: re-snap to icon 0 (the pre-selected centre icon).  For the
     * vertical grid this block used to override the correct initial scroll
     * and force the view to row 0 on entry — skip it there. */
    if (g_layout_mode != HONEYCOMB_MODE_VERTICAL_GRID) {
        uint16_t col, row;
        layout_get_icon_col_row_by_idx(0, &col, &row);
        g_menu->center_icon = *honeycomb_get_icon_obj(row, col);
        if (g_menu->center_icon) {
            lv_obj_scroll_to_view(g_menu->center_icon, LV_ANIM_OFF);
        }
    }
    lv_obj_invalidate(g_menu->page_obj);  /* force first paint */

    if (g_layout_mode == HONEYCOMB_MODE_VERTICAL_GRID &&
        g_config.honeycomb_vertical_entry_animation) {
        int total_icons = g_distinct_icons ? ICON_COUNT : g_icon_count;
        lv_obj_t *entry_icon = honeycomb_vertical_entry_icon(total_icons);
        if (entry_icon) g_menu->center_icon = entry_icon;

        const int anim_row_min = 0;   /* all visible rows (0..5) animate */

        /* Every icon starts at opacity 0 (hidden) from populate.  Restore
         * every icon that will NOT be entry-animated (rows with no timer,
         * or icons that aren't in the viewport) to full opacity so the
         * grid is complete immediately.  (The entry timers themselves are
         * created AFTER the backlight fade-in, at the end of create.) */
        for (int idx = 0; idx < total_icons; idx++) {
            uint16_t col, row;
            layout_get_icon_col_row_by_idx((uint16_t)idx, &col, &row);
            bool anim_this = ((int)row >= anim_row_min &&
                              honeycomb_icon_in_window(col, row));
            if (!anim_this) {
                lv_obj_t *icon = *honeycomb_get_icon_obj(row, col);
                if (icon) lv_obj_set_style_opa(icon, LV_OPA_COVER, 0);
            }
        }
    }

    /* Snap scroll to the centre icon so icons are visible immediately.
     * Hex only — the vertical grid is already centred by the scroll_by
     * above (row 2), and re-snapping it here only caused a jump. */
    if (g_layout_mode != HONEYCOMB_MODE_VERTICAL_GRID && g_menu->center_icon) {
        lv_obj_scroll_to_view(g_menu->center_icon, LV_ANIM_OFF);
    }

    /* Render one frame while the backlight is still dark, then fade in. */
    lv_timer_handler();
    honeycomb_menu_fade_in();

    /* Catch-up transforms fire right after the backlight is up, before the
     * cascade starts (~80ms), so a forced full transform/redraw never lands
     * mid-animation (the old 300ms one landed between row 1 and row 2 and
     * reset the animation). */
    lv_timer_t *t0 = lv_timer_create(delayed_refresh_cb, 20, NULL);
    lv_timer_set_repeat_count(t0, 1);
    lv_timer_t *t1 = lv_timer_create(delayed_refresh_cb, 60, NULL);
    lv_timer_set_repeat_count(t1, 1);

    /* Create the animation timers AFTER the (blocking) backlight fade-in.
     * If they were created earlier they'd already be overdue when the LVGL
     * task gets the display lock back and would ALL fire at once — killing
     * the cascade and hiding the first row's jelly behind the dim backlight. */
    bool entry_on = (g_layout_mode == HONEYCOMB_MODE_VERTICAL_GRID)
                        ? g_config.honeycomb_vertical_entry_animation
                        : g_config.honeycomb_hex_entry_animation;
    if (entry_on) {
        g_menu->entry_timer_count = 0;
        if (g_layout_mode == HONEYCOMB_MODE_VERTICAL_GRID) {
            int total_icons = g_distinct_icons ? ICON_COUNT : g_icon_count;
            int last_row = honeycomb_get_vertical_row_count(total_icons);

            /* Continuous cascade: row 0 pops in right after the backlight
             * is up, then every next row follows 80ms later so the rows
             * flow into each other without a visible pause.  All 6 visible
             * rows (0..5) are animated. */
            const int anim_row_min = 0;
            for (int row = anim_row_min; row <= last_row; row++) {
                if (!honeycomb_row_in_window(row, total_icons)) continue;

                int delay_ms = row * 80;   /* row 0 = 0ms, row 1 = 80ms, ... */
                lv_timer_t *t = lv_timer_create(honeycomb_vertical_enter_anim_step,
                                                delay_ms, (void *)(uintptr_t)row);
                lv_timer_set_repeat_count(t, 1);
                g_menu->entry_timers[g_menu->entry_timer_count++] = t;
            }
        } else if (g_layout_mode == HONEYCOMB_MODE_HEX_SPIRAL) {
            /* Centre-out: the inner ring pops in first, then each outer
             * ring follows so it lands after the ring inside it (the user
             * wants inner rings ready before the outer ones). */
            int total_icons = g_distinct_icons ? ICON_COUNT : g_icon_count;
            int max_ring = honeycomb_hex_ring_of_idx(total_icons - 1);
            for (int ring = 0; ring <= max_ring; ring++) {
                int delay_ms = ring * 90;
                lv_timer_t *t = lv_timer_create(honeycomb_hex_enter_anim_step,
                                                delay_ms, (void *)(uintptr_t)ring);
                lv_timer_set_repeat_count(t, 1);
                g_menu->entry_timers[g_menu->entry_timer_count++] = t;
            }
        }

        /* One-shot: drop the temporary circular clip once the cascade is
         * done (the scale anims keep the radius alive while they run). */
        lv_timer_t *tc = lv_timer_create(honeycomb_entry_anim_done_cb, 900, NULL);
        lv_timer_set_repeat_count(tc, 1);
    }

    ESP_LOGI(TAG, "Honeycomb menu ready");
}

void honeycomb_menu_destroy(void)
{
    /* Re-entrancy guard.  Deleting the page's scroll animation below fires
     * LV_EVENT_SCROLL_END synchronously, and that handler calls
     * honeycomb_menu_destroy() again.  The nested call used to free g_menu and
     * the outer call then dereferenced NULL (SIGSEGV when launching from an
     * icon). */
    if (!g_menu || s_destroying) return;
    s_destroying = true;

    honeycomb_menu_t *menu = g_menu;
    g_menu = NULL;              /* look inactive to any late callback */

    ESP_LOGI(TAG, "Destroying honeycomb menu...");

    /* Fade the backlight out before tearing the screen down. */
    honeycomb_brightness_ramp(0, 6);

    /* Remove display event callback FIRST */
    lv_display_remove_event_cb_with_user_data(lv_display_get_default(), refr_start_cb, NULL);

    /* Detach the gesture handler before the anim delete: SCROLL_END must not
     * reach page_event_cb while the menu is being freed. */
    if (menu->page_obj) {
        lv_obj_remove_event_cb(menu->page_obj, page_event_cb);
    }

    /* Stop the spring/touch-fade driver before freeing any state. */
    if (menu->fx_timer) {
        lv_timer_delete(menu->fx_timer);
        menu->fx_timer = NULL;
    }

    /* Cancel any pending vertical entry-animation timers so a destroyed
     * menu can't re-fire them on the next, re-created menu. */
    for (int i = 0; i < menu->entry_timer_count; i++) {
        if (menu->entry_timers[i]) lv_timer_delete(menu->entry_timers[i]);
    }
    menu->entry_timer_count = 0;

    if (menu->page_obj) {
        /* Kill any in-flight glide/snap animation on the page before the
         * object (and its callbacks) are freed — otherwise a late anim tick
         * dereferences freed memory and panics. */
        lv_anim_delete(menu->page_obj, NULL);
        lv_obj_del(menu->page_obj);
        menu->page_obj = NULL;
    }

    heap_caps_free(menu->icon_list);
    heap_caps_free(menu->icon_pivot);
    heap_caps_free(menu);

    s_destroying = false;

    ESP_LOGI(TAG, "Honeycomb menu destroyed");
}

bool honeycomb_menu_is_active(void)
{
    return (g_menu != NULL);
}

void honeycomb_menu_set_distinct_icons(bool enable)
{
    g_distinct_icons = enable;
    g_config.honeycomb_distinct_icons = enable;
    ESP_LOGI(TAG, "Distinct icons: %s", enable ? "ON" : "OFF");
}

bool honeycomb_menu_get_distinct_icons(void)
{
    return g_distinct_icons;
}

void honeycomb_menu_set_pre_scaled_icons(bool enable)
{
    /* Pre-scaled 96×96 RGB565 is now the only icon source — always ON.
     * Kept for backward compatibility with settings_ui.c toggle. */
    if (!enable) {
        ESP_LOGW(TAG, "Pre-scaled icons are always ON (96×96 is the only format)");
    }
}

bool honeycomb_menu_get_pre_scaled_icons(void)
{
    return true;  /* Always ON */
}

/*============================================================================
 * Icon Count — valid counts per layout mode
 *============================================================================*/

/**
 * Hex-spiral valid counts (complete rings): 1, 7, 19, 37, 61, 91, 127, …
 * Formula: icons = 3·r² + 3·r + 1  where r = ring index (0-based)
 */
static const int s_hex_valid_counts[] = { 1, 7, 19, 37, 61, 91, 127 };
#define HEX_COUNT_LEN  (sizeof(s_hex_valid_counts) / sizeof(s_hex_valid_counts[0]))

/**
 * Vertical-grid valid counts (full rows, last row matches its expected width):
 * Rows: 0(3), 1(4), 2(3), 3(4), 4(3), 5(4), 6(3), 7(4), 8(3), 9(4)
 * Valid totals: 3, 7, 10, 14, 17, 21, 24, 28, 31, 35
 */
static const int s_vert_valid_counts[] = { 3, 7, 10, 14, 17, 21, 24, 28, 31, 35 };
#define VERT_COUNT_LEN  (sizeof(s_vert_valid_counts) / sizeof(s_vert_valid_counts[0]))

static int clamp_icon_count(int desired)
{
    const int *vals;
    int len;

    if (g_layout_mode == HONEYCOMB_MODE_VERTICAL_GRID) {
        vals = s_vert_valid_counts;
        len  = VERT_COUNT_LEN;
    } else {
        vals = s_hex_valid_counts;
        len  = HEX_COUNT_LEN;
    }

    /* Clamp to nearest valid value */
    if (desired <= vals[0]) return vals[0];
    for (int i = 1; i < len; i++) {
        if (desired <= vals[i]) {
            /* Pick closer of vals[i-1] and vals[i] */
            return (desired - vals[i-1] <= vals[i] - desired) ? vals[i-1] : vals[i];
        }
    }
    return vals[len - 1];
}

void honeycomb_menu_set_icon_count(int count)
{
    /* When distinct-icons is ON, count is always ICON_COUNT — ignore */
    if (g_distinct_icons) {
        ESP_LOGI(TAG, "Icon count: %d (distinct-icons ON, fixed at %d)", count, (int)ICON_COUNT);
        return;
    }

    int clamped = clamp_icon_count(count);
    g_icon_count = clamped;
    ESP_LOGI(TAG, "Icon count: %d → clamped to %d (mode=%s)",
             count, clamped,
             g_layout_mode == HONEYCOMB_MODE_VERTICAL_GRID ? "vertical" : "hex");
}

int honeycomb_menu_get_icon_count(void)
{
    if (g_distinct_icons) return (int)ICON_COUNT;
    return g_icon_count;
}

int honeycomb_menu_get_default_icon_count(void)
{
    if (g_layout_mode == HONEYCOMB_MODE_VERTICAL_GRID) {
        return 11;  /* vertical count with an odd middle row and center 3-icon row */
    }
    return s_hex_valid_counts[2];       /* 19 — 3 rings (good default for hex) */
}

void honeycomb_menu_set_res_divisor(int div)
{
    if (div < 1) div = 1;
    if (div > 5) div = 5;
    g_res_divisor = div;
    ESP_LOGI(TAG, "Res divisor: 1/%d (RAM-only)", div);
}

int honeycomb_menu_get_res_divisor(void)
{
    return g_res_divisor;
}

int honeycomb_menu_icon_count(void)
{
    return (int)ICON_COUNT;
}

const lv_image_dsc_t *honeycomb_menu_icon_dsc(int icon_id)
{
    if (icon_id == JSAPP_ICON_SLOT && s_jsapp_icon)
        return s_jsapp_icon;
    if (icon_id < 0 || icon_id >= (int)ICON_COUNT) return NULL;
    return s_icons[icon_id];
}

void honeycomb_menu_layout_coord(int idx, int32_t *x, int32_t *y)
{
    uint16_t col, row;
    layout_get_icon_col_row_by_idx((uint16_t)idx, &col, &row);
    layout_get_icons_init_coordinate(row, col, x, y);
}
